## boards/arm/apricity_gateway_nrf52840/Kconfig
```kconfig
# Apricity Gateway:91 nRF52840 board configuration
#
# Copyright (c) 2020 Nordic Semiconductor ASA
#
# SPDX-License-Identifier: LicenseRef-BSD-5-Clause-Nordic

if BOARD_APRICITY_GATEWAY_NRF52840

config BOARD_ENABLE_DCDC
	bool "Enable DCDC mode"
	select SOC_DCDC_NRF52X
	default y

config BOARD_APRICITY_GATEWAY_NRF52840_RESET
	bool "Enable GPIO reset line"
	default y
	help
	 Let the nRF52840 be reset from the nRF9160 via a GPIO line.
	 The GPIO line may only be one of the 8 interface pins.
	 The line is active high.

if BOARD_APRICITY_GATEWAY_NRF52840_RESET

comment "nRF52840 pins"

config BOARD_APRICITY_GATEWAY_NRF52840_RESET_PORT
	int "GPIO port for reset"
	default 1
	help
	 GPIO port on nRF52840 for reset signal from nRF9160.

config BOARD_APRICITY_GATEWAY_NRF52840_RESET_PIN
	int "GPIO pin for reset"
	default 2
	help
	 GPIO pin on nRF52840 for reset signal from nRF9160.

config BOARD_APRICITY_GATEWAY_NRF52840_BOOT_SELECT_PORT
	int "GPIO port for boot select"
	default 0
	help
	  GPIO port on nRF52840 for MCUboot select signal from nRF9160.
	  Set up in open-drain mode, and used as a signal back to
	  nRF9160 to indicate nRF52840 is running application.

config BOARD_APRICITY_GATEWAY_NRF52840_BOOT_SELECT_PIN
	int "GPIO pin for boot select"
	default 12
	help
	  GPIO pin for MCUboot select signal and application run signal.

endif # BOARD_PCA10090_NRF52840_RESET

endif # BOARD_APRICITY_GATEWAY_NRF52840
```

## boards/arm/apricity_gateway_nrf52840/Kconfig.board
```kconfig
# nRF52840 APRICITY_GATEWAY board configuration
#
# Copyright (c) 2020 Nordic Semiconductor ASA
#
# SPDX-License-Identifier: LicenseRef-BSD-5-Clause-Nordic

config BOARD_APRICITY_GATEWAY_NRF52840
	bool "nRF52840 APRICITY_GATEWAY"
	depends on SOC_NRF52840_QIAA
# The GPIO driver is required by this board's initialization code
# (board.c), so it is forced here to be enabled always, not only
# enabled by default (in defconfig).
select GPIO
```

## boards/arm/apricity_gateway_nrf52840/Kconfig.defconfig
```kconfig
# nRF52840 APRICITY_GATEWAY board configuration
#
# Copyright (c) 2020 Nordic Semiconductor ASA
#
# SPDX-License-Identifier: LicenseRef-BSD-5-Clause-Nordic

if BOARD_APRICITY_GATEWAY_NRF52840

config BOARD
	default "apricity_gateway_nrf52840"

config BT_CTLR
	default BT

if USB

config IEEE802154_NRF5
	default y
	depends on IEEE802154

config USB_NRFX
	def_bool y

config USB_DEVICE_STACK
	def_bool y

endif # USB

endif # BOARD_APRICITY_GATEWAY_NRF52840
```
